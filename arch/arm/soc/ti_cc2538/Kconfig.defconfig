## arch/arm/soc/ti_cc2538/Kconfig.defconfig
```kconfig
# Kconfig - TI CC2538 platform configuration options

#
# Copyright (c) 2016 http://iot-fans.xyz
#
# Licensed under the Apache License, Version 2.0 (the "License");
# you may not use this file except in compliance with the License.
# You may obtain a copy of the License at
#
#     http://www.apache.org/licenses/LICENSE-2.0
#
# Unless required by applicable law or agreed to in writing, software
# distributed under the License is distributed on an "AS IS" BASIS,
# WITHOUT WARRANTIES OR CONDITIONS OF ANY KIND, either express or implied.
# See the License for the specific language governing permissions and
# limitations under the License.
#

if SOC_TI_CC2538

config SOC
	default ti_cc2538

config NUM_IRQ_PRIO_BITS
	int
	default 3

config NUM_IRQS
	int
	default 147

config SYS_CLOCK_HW_CYCLES_PER_SEC
	int
	default 32000000

config SRAM_SIZE
	default 32

config SRAM_BASE_ADDRESS
	default 0x20000000 

config FLASH_SIZE
	default 512 

config FLASH_BASE_ADDRESS
	default 0x00200000

endif # SOC_TI_CC2538
```

## arch/arm/soc/ti_cc2538/Kconfig.soc
```kconfig
config SOC_TI_CC2538
	bool "TI CC2538 Platform"
	select CPU_CORTEX_M
	select CPU_CORTEX_M3
```

## boards/cc2538/cc2538_defconfig
```kconfig
CONFIG_ARM=y
CONFIG_SYS_CLOCK_HW_CYCLES_PER_SEC=12000000
CONFIG_SOC_TI_CC2538=y
CONFIG_BOARD_CC2538=y
```

## drivers/serial/Kconfig.cc2538
```kconfig
menuconfig UART_CC2538
	bool "CC2538 serial driver"
	default n
	select SERIAL_HAS_DRIVER
	help
	This option enables the CC2538 serial driver.
	This specific driver can be used for the serial hardware
	available at the Freescale FRDM K64F platform.

# ---------- Port 0 ----------

menuconfig UART_CC2538_PORT_0
	bool "Enable CC2538 UART Port 0"
	default y
	depends on UART_CC2538
	help
	  This tells the driver to configure the UART port at boot, depending on
	  the additional configure options below.

config UART_CC2538_PORT_0_NAME
	string "Port 0 Device Name"
	default "UART_0"
	depends on UART_CC2538_PORT_0
	help
	  This is the device name for UART, and is included in the device
	  struct.

config UART_CC2538_PORT_0_IRQ_PRI
	int "Port 0 Interrupt Priority (Interrupt support)"
	range 0 7
	default 0
	depends on UART_CC2538_PORT_0
	depends on UART_INTERRUPT_DRIVEN
	help
	  The interrupt priority for UART port.

config UART_CC2538_PORT_0_BAUD_RATE
	int "Port 0 Baud Rate"
	range 1200 1000000
	default 115200
	depends on UART_CC2538_PORT_0
	help
	  The baud rate for UART port to be set to at boot.


config UART_NRF5_GPIO_TX_PIN
	int "TX Pin Number"
	range 0 31
	default 6
	depends on UART_NRF5
	depends on GPIO_NRF5
	help
	  The GPIO pin to use for TX.

config UART_NRF5_GPIO_RX_PIN
	int "RX Pin Number"
	range 0 31
	default 8
	depends on UART_NRF5
	depends on GPIO_NRF5
	help
	  The GPIO pin to use for RX.
# ---------- Port 1 ----------

menuconfig UART_CC2538_PORT_1
	bool "Enable CC2538 UART Port 1"
	default n
	depends on UART_CC2538
	help
	  This tells the driver to configure the UART port at boot, depending on
	  the additional configure options below.

config UART_CC2538_PORT_1_NAME
	string "Port 1 Device Name"
	default "UART_1"
	depends on UART_CC2538_PORT_1
	help
	  This is the device name for UART, and is included in the device
	  struct.

config UART_CC2538_PORT_1_IRQ_PRI
	int "Port 1 Interrupt Priority"
	default 0
	depends on UART_CC2538_PORT_1
	help
	  The interrupt priority for UART port.

config UART_CC2538_PORT_1_BAUD_RATE
	int "Port 1 Baud Rate"
	default 0
	depends on UART_CC2538_PORT_1
	help
	  The baud rate for UART port to be set to at boot.

	  Leave at 0 to skip initialization.

config UART_NRF5_FLOW_CONTROL
	bool "Enable Flow Control"
	default n
	depends on UART_NRF5
	help
	  Enable Flow Control.
	  If selected, additionally two pins,
	  RTS and CTS has to be
	  configured.
```
